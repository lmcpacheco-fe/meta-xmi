## conf/machine/xmi-imx8mp.conf
```bitbake
#@TYPE: Machine
#@NAME: i.MX 8M Plus XMI baord with DDR4
#@SOC: i.MX8MP
#@DESCRIPTION: Machine configuration for XMI i.MX 8M Plus XMI board with DDR4
#@MAINTAINER: Don Gunn <don.gunn@futureelectronics.com>

require include/imx8mp-evk.inc
MACHINEOVERRIDES =. "mx8mp-nxp-bsp:"
# FIXME: This machine is not yet supported by u-boot-fslc, so for now
# use u-boot-imx for mainline.
IMX_DEFAULT_BOOTLOADER:use-mainline-bsp = "u-boot-imx"

KERNEL_DEVICETREE_BASENAME = "${MACHINE}"

UBOOT_CONFIG_BASENAME = "imx8mp_ddr4_evk"
UBOOT_CONFIG[nand] = "${UBOOT_CONFIG_BASENAME}_nand_defconfig"

# Set DDR FIRMWARE
DDR_FIRMWARE_VERSION = "202006"
DDR_FIRMWARE_NAME = " \
    ddr4_dmem_1d_${DDR_FIRMWARE_VERSION}.bin \
    ddr4_imem_1d_${DDR_FIRMWARE_VERSION}.bin \
    ddr4_dmem_2d_${DDR_FIRMWARE_VERSION}.bin \
    ddr4_imem_2d_${DDR_FIRMWARE_VERSION}.bin \
"

IMXBOOT_TARGETS_BASENAME = "flash_ddr4_evk"

# Mainline BSP doesn't support DDR4 so it must be set to nxp.
# Also this machine isn't supported by u-boot-fslc but imx8mp-evk.inc already
# set the bootloader to u-boot-imx instead when NXP BSP is used.
IMX_DEFAULT_BSP = "nxp"

UBOOT_DELTA_CONFIG="${WORKDIR}/WCS-uboot-config/*"
```
